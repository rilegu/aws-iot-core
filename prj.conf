## CMakeLists.txt
```
# SPDX-License-Identifier: Apache-2.0

cmake_minimum_required(VERSION 3.20.0)

find_package(Zephyr REQUIRED HINTS $ENV{ZEPHYR_BASE})
project(aws_iot_mqtt)

if(USE_DUMMY_CREDS)
  set(creds "src/creds/dummy.c")
else()
  if(NOT EXISTS ${APPLICATION_SOURCE_DIR}/src/creds/key.c OR
    NOT EXISTS ${APPLICATION_SOURCE_DIR}/src/creds/cert.c OR
    NOT EXISTS ${APPLICATION_SOURCE_DIR}/src/creds/ca.c)
    message(FATAL_ERROR
      "Credentials not found. Please run "
      "'python3 src/creds/convert_keys.py' before building"
    )
  endif()

  set(creds "src/creds/ca.c" "src/creds/key.c" "src/creds/cert.c")
endif()

# Add all source files
target_sources(app PRIVATE
  "src/main.c"
  "src/aws/aws_iot_core.c"
  "src/mqtt/aws_mqtt.c"
  "src/heartbeat/heartbeat.c"
  ${creds}
)

# Add include directories for the headers
target_include_directories(app PRIVATE
  "src"
)

include(${ZEPHYR_BASE}/samples/net/common/common.cmake)
```

## Kconfig
```
mainmenu "AWS IoT Core MQTT sample application"

menu "AWS"

config AWS_ENDPOINT
	string "AWS endpoint"
	default ""
	help
	  Endpoint(hostname) of the AWS MQTT broker.
	  Note that the endpoint is different when using AWS Device Advisor.

config AWS_MQTT_PORT
	int "MQTT Port"
	default 8883
	help
	  Set port of AWS MQTT broker.

config AWS_THING_NAME
	string "AWS Thing name"
	default "myThingName"
	help
	  Set the AWS Thing name created on IoT Console

config AWS_SUBSCRIBE_TOPIC
	string "MQTT subscribe topic"
	default "myThingName/downlink"
	help
	  MQTT topic the client should subscribe to.

config AWS_PUBLISH_TOPIC
	string "MQTT publish topic"
	default "myThingName/data"
	help
	  MQTT topic the client should publish to.

choice AWS_TEST_SUITE
	prompt "Device Advisor test suite"
	default AWS_TEST_SUITE_NONE
	help
	  Select the AWS Device Advisor test suite to run.

config AWS_TEST_SUITE_NONE
	bool "No test suite running"

config AWS_TEST_SUITE_DQP
	bool "Device Qualification Program (DQP)"
	help
	  Make sure your region supports AWS Device Advisor for DQP

config AWS_TEST_SUITE_RECV_QOS1
	bool "Test suite for receiving QoS 1 messages"
	help
	  For single test case "MQTT Client Puack QoS1"

endchoice

config AWS_QOS
	int "MQTT QoS"
	default 0 if AWS_TEST_SUITE_DQP
	default 1 if AWS_TEST_SUITE_RECV_QOS1
	default 0
	range 0 1
	help
	  Quality of Service to use for publishing and subscribing to topics.
	  Notes:
		-Use QoS 0 when passing DQP test suite
	  	- QoS 2 is not supported by AWS MQTT broker

config AWS_EXPONENTIAL_BACKOFF
	bool "enable exponential backoff"
	default n if AWS_TEST_SUITE_DQP || AWS_TEST_SUITE_RECV_QOS1
	default y
	help
	  Enable AWS exponential backoff for reconnecting to AWS MQTT broker.

endmenu

source "samples/net/common/Kconfig"
source "Kconfig.zephyr"
```

## prj.conf
```kconfig
CONFIG_AWS_ENDPOINT="a2p7td5hbs1irq-ats.iot.us-east-2.amazonaws.com"
CONFIG_AWS_MQTT_PORT=8883
CONFIG_AWS_THING_NAME="zephyr_sample"
CONFIG_AWS_PUBLISH_TOPIC="zephyr/pub"
CONFIG_AWS_SUBSCRIBE_TOPIC="zephyr/sub"
CONFIG_AWS_QOS=1
CONFIG_AWS_TEST_SUITE_DQP=n

CONFIG_MAIN_STACK_SIZE=4096
CONFIG_ENTROPY_GENERATOR=y
CONFIG_TEST_RANDOM_GENERATOR=y
CONFIG_INIT_STACKS=y
CONFIG_HW_STACK_PROTECTION=y
CONFIG_REQUIRES_FULL_LIBC=y
CONFIG_JSON_LIBRARY=y
CONFIG_POSIX_API=y

# DNS
CONFIG_DNS_RESOLVER=y
CONFIG_DNS_RESOLVER_ADDITIONAL_BUF_CTR=2
CONFIG_DNS_RESOLVER_MAX_SERVERS=1
CONFIG_DNS_SERVER_IP_ADDRESSES=y
CONFIG_DNS_SERVER1="8.8.8.8"
CONFIG_NET_SOCKETS_DNS_TIMEOUT=5000
CONFIG_DNS_RESOLVER_LOG_LEVEL_DBG=n

# Generic networking options
CONFIG_NETWORKING=y
CONFIG_NET_UDP=y
CONFIG_NET_TCP=y
CONFIG_NET_IPV6=y
CONFIG_NET_IPV4=y
CONFIG_NET_SOCKETS=y
CONFIG_NET_SOCKETS_SOCKOPT_TLS=y

# Network configuration
CONFIG_NET_CONFIG_SETTINGS=y
CONFIG_NET_CONFIG_NEED_IPV4=y
CONFIG_NET_DHCPV4=y

# SNTP
CONFIG_SNTP=y
CONFIG_NET_CONFIG_CLOCK_SNTP_INIT=y
CONFIG_NET_CONFIG_SNTP_INIT_SERVER="0.pool.ntp.org"

# Logging
CONFIG_LOG=y
CONFIG_LOG_TIMESTAMP_USE_REALTIME=y
CONFIG_POSIX_C_LANG_SUPPORT_R=y

# Network buffers
CONFIG_NET_PKT_RX_COUNT=32
CONFIG_NET_PKT_TX_COUNT=16
CONFIG_NET_BUF_RX_COUNT=64
CONFIG_NET_BUF_TX_COUNT=32

# MQTT
CONFIG_MQTT_LIB=y
CONFIG_MQTT_LIB_TLS=y
CONFIG_MQTT_KEEPALIVE=60
CONFIG_MQTT_LIB_TLS_USE_ALPN=y

# TLS
CONFIG_MBEDTLS=y
CONFIG_MBEDTLS_BUILTIN=y
CONFIG_MBEDTLS_ENABLE_HEAP=y
CONFIG_MBEDTLS_HEAP_SIZE=65536
CONFIG_MBEDTLS_SSL_MAX_CONTENT_LEN=16384
CONFIG_MBEDTLS_PEM_CERTIFICATE_FORMAT=y
CONFIG_MBEDTLS_SERVER_NAME_INDICATION=y
CONFIG_MBEDTLS_AES_ROM_TABLES=y
CONFIG_MBEDTLS_TLS_VERSION_1_2=y
CONFIG_MBEDTLS_MEMORY_DEBUG=y
CONFIG_MBEDTLS_HAVE_TIME_DATE=y
CONFIG_MBEDTLS_SSL_ALPN=y
CONFIG_SHELL=y
CONFIG_NET_SHELL=y

# Debugging options
# CONFIG_MBEDTLS_DEBUG=y
# CONFIG_MBEDTLS_LOG_LEVEL_DBG=y
# CONFIG_LOG_PROCESS_THREAD_SLEEP_MS=1
# CONFIG_LOG_BUFFER_SIZE=50000
```

## src/main.c
```c
#include "aws/aws_iot_core.h"
#include "aws/aws_iot_config.h"
#include "heartbeat/heartbeat.h"
#include <zephyr/logging/log.h>
#include <zephyr/kernel.h>
#include "net_sample_common.h"

#if defined(CONFIG_MBEDTLS_MEMORY_DEBUG)
#include <mbedtls/memory_buffer_alloc.h>
#endif

LOG_MODULE_REGISTER(main, LOG_LEVEL_DBG);

static struct aws_iot_client aws_client;

int main(void)
{
	int ret;

	LOG_INF("AWS IoT Core MQTT Client starting...");

	/* Setup AWS IoT credentials */
	ret = aws_iot_setup_credentials();
	if (ret != 0) {
		LOG_ERR("Failed to setup credentials: %d", ret);
		return ret;
	}

	/* Wait for network connectivity */
	wait_for_network();

	/* Initialize AWS IoT client */
	ret = aws_iot_client_init(&aws_client);
	if (ret != 0) {
		LOG_ERR("Failed to initialize AWS IoT client: %d", ret);
		return ret;
	}

	/* Main application loop */
	for (;;) {
		/* Resolve broker address */
		ret = aws_iot_resolve_broker_addr(&aws_client);
		if (ret != 0) {
			LOG_ERR("Failed to resolve broker address: %d", ret);
			k_sleep(K_SECONDS(5));
			continue;
		}

		/* Connect to AWS IoT Core */
		ret = aws_iot_client_connect(&aws_client);
		if (ret != 0) {
			LOG_ERR("Failed to connect to AWS IoT Core: %d", ret);
			k_sleep(K_SECONDS(5));
			continue;
		}

		LOG_INF("=> Connected to AWS IoT Core successfully");

		/* Run the client loop */
		ret = aws_iot_client_loop(&aws_client);
		if (ret != 0) {
			LOG_ERR("AWS IoT client loop failed: %d", ret);
		}

		/* Disconnect and cleanup */
		aws_iot_client_disconnect(&aws_client);

		LOG_INF("=> Disconnected from AWS IoT Core");

#if defined(CONFIG_MBEDTLS_MEMORY_DEBUG)
		size_t cur_used, cur_blocks, max_used, max_blocks;

		mbedtls_memory_buffer_alloc_cur_get(&cur_used, &cur_blocks);
		mbedtls_memory_buffer_alloc_max_get(&max_used, &max_blocks);
		LOG_INF("mbedTLS heap usage: MAX %u/%u (%u) CUR %u (%u)", max_used,
			CONFIG_MBEDTLS_HEAP_SIZE, max_blocks, cur_used, cur_blocks);
#endif

		/* Wait before attempting to reconnect */
		k_sleep(K_SECONDS(1));
	}

	return 0;
}

// Start led blinking task
K_THREAD_DEFINE(heartbeat_id, HEARTBEAT_THREAD_STACKSIZE, heartbeat_task, NULL, NULL, NULL, 2, 0,
		0);
```

## src/aws_iot_config.h
```c
#ifndef AWS_IOT_CONFIG_H
#define AWS_IOT_CONFIG_H

/* AWS IoT Core Configuration Constants */
#define SNTP_SERVER     "0.pool.ntp.org"
#define AWS_BROKER_PORT CONFIG_AWS_MQTT_PORT

/* Buffer sizes */
#define MQTT_BUFFER_SIZE 256u
#define APP_BUFFER_SIZE  4096u

/* Retry and backoff configuration */
#define MAX_RETRIES         10u
#define BACKOFF_EXP_BASE_MS 1000u
#define BACKOFF_EXP_MAX_MS  60000u
#define BACKOFF_CONST_MS    5000u

/* TLS certificate tags */
#define TLS_TAG_DEVICE_CERTIFICATE 1
#define TLS_TAG_DEVICE_PRIVATE_KEY 1
#define TLS_TAG_AWS_CA_CERTIFICATE 2

/* MQTT client configuration */
#define MQTT_CLIENT_NAME CONFIG_AWS_THING_NAME

/* ALPN protocol for port 443 */
#if (CONFIG_AWS_MQTT_PORT == 443 && !defined(CONFIG_MQTT_LIB_WEBSOCKET))
#define AWS_ALPN_PROTOCOL "x-amzn-mqtt-ca"
#endif

#endif /* AWS_IOT_CONFIG_H */
```

## src/aws_iot_core.c
```c
#include "aws_iot_core.h"
#include "aws_iot_config.h"
#include "creds/creds.h" // Provides public_cert, private_key, ca_cert
#include <errno.h>
#include <stdio.h>
#include <stdlib.h>
#include <string.h>
#include <zephyr/net/socket.h>
#include <zephyr/net/dns_resolve.h>
#include <zephyr/net/mqtt.h> // Keep for mqtt_publish_param
#include <zephyr/net/tls_credentials.h>
#include <zephyr/data/json.h>
#include <zephyr/random/random.h>
#include <zephyr/logging/log.h>
#include <zephyr/kernel.h>

LOG_MODULE_REGISTER(aws_iot_core, LOG_LEVEL_DBG);

// json_descr remains here as it's specific to aws_iot_publish_payload
static const struct json_obj_descr json_descr[] = {
	JSON_OBJ_DESCR_PRIM(struct aws_iot_publish_payload, counter, JSON_TOK_NUMBER),
};

/**
 * @brief Handles received MQTT messages and processes them as AWS IoT application payloads.
 *
 * @param client Pointer to AWS IoT client structure.
 * @param pub MQTT publish parameters.
 * @return Number of bytes received, negative error code on failure.
 */
static ssize_t aws_iot_handle_received_message(struct aws_iot_client *client,
					       const struct mqtt_publish_param *pub)
{
	if (!client || !pub) {
		return -EINVAL;
	}

	int ret;
	size_t received = 0u;
	const size_t message_size = pub->message.payload.len;
	const bool discarded = message_size > sizeof(client->app_buffer);

	LOG_INF("=> RECEIVED on topic \"%s\" [ id: %u qos: %u ] payload: %u / %u B",
		(const char *)pub->message.topic.topic.utf8, pub->message_id,
		pub->message.topic.qos, message_size, (uint32_t)sizeof(client->app_buffer));

	while (received < message_size) {
		// Read payload from the MQTT client, store in app_buffer (or discard if msg is too
		// large)
		uint8_t *p = discarded ? client->app_buffer : &client->app_buffer[received];

		ret = mqtt_read_publish_payload_blocking(&client->mqtt.mqtt_client, p,
							 sizeof(client->app_buffer));
		if (ret < 0) {
			return ret;
		}

		received += ret;
	}

	if (!discarded) {
		LOG_HEXDUMP_DBG(client->app_buffer, MIN(message_size, 256u), "Received payload:");
	}

	/* Send ACK based on QoS */
	switch (pub->message.topic.qos) {
	case MQTT_QOS_1_AT_LEAST_ONCE: {
		struct mqtt_puback_param puback;

		puback.message_id = pub->message_id;
		mqtt_publish_qos1_ack(&client->mqtt.mqtt_client, &puback);
	} break;
	case MQTT_QOS_2_EXACTLY_ONCE: /* unhandled (not supported by AWS :( */
	case MQTT_QOS_0_AT_MOST_ONCE: /* nothing to do */
	default:
		break;
	}

	return discarded ? -ENOMEM : received;
}

/**
 * @brief Application-specific MQTT event handler.
 * This function is registered with the aws_mqtt module to handle events.
 *
 * @param mqtt_client Pointer to the Zephyr MQTT client instance.
 * @param evt Pointer to the MQTT event.
 */
static void aws_iot_mqtt_event_handler(struct mqtt_client *mqtt_client, const struct mqtt_evt *evt)
{
	struct aws_iot_client *client =
		CONTAINER_OF(mqtt_client, struct aws_iot_client, mqtt.mqtt_client);

	switch (evt->type) {
	case MQTT_EVT_CONNACK: {
		// Connection acknowledged, trigger subscription
		client->do_subscribe = true;
	} break;

	case MQTT_EVT_PUBLISH: {
		const struct mqtt_publish_param *pub = &evt->param.publish;

		// Handle the received message and increment counter
		aws_iot_handle_received_message(client, pub);
		client->messages_received_counter++;
#if !defined(CONFIG_AWS_TEST_SUITE_RECV_QOS1)
		// Trigger a publish after receiving a message (if not testing QoS1 receive)
		client->do_publish = true;
#endif
	} break;

	case MQTT_EVT_SUBACK: {
#if !defined(CONFIG_AWS_TEST_SUITE_RECV_QOS1)
		// Subscription acknowledged, trigger initial publish
		client->do_publish = true;
#endif
	} break;

	case MQTT_EVT_DISCONNECT: {
		// Disconnected, client->mqtt.connected will be set to false by aws_mqtt
	} break;

	case MQTT_EVT_PUBACK:
	case MQTT_EVT_PUBREC:
	case MQTT_EVT_PUBREL:
	case MQTT_EVT_PUBCOMP:
	case MQTT_EVT_PINGRESP:
	case MQTT_EVT_UNSUBACK:
	default:
		break;
	}
}

int aws_iot_setup_credentials(void)
{
	int ret;

	// Add device certificate
	ret = tls_credential_add(TLS_TAG_DEVICE_CERTIFICATE, TLS_CREDENTIAL_SERVER_CERTIFICATE,
				 public_cert, public_cert_len);
	if (ret < 0) {
		LOG_ERR("Failed to add device certificate: %d", ret);
		goto exit;
	}

	// Add device private key
	ret = tls_credential_add(TLS_TAG_DEVICE_PRIVATE_KEY, TLS_CREDENTIAL_PRIVATE_KEY,
				 private_key, private_key_len);
	if (ret < 0) {
		LOG_ERR("Failed to add device private key: %d", ret);
		goto exit;
	}

	// Add AWS CA certificate
	ret = tls_credential_add(TLS_TAG_AWS_CA_CERTIFICATE, TLS_CREDENTIAL_CA_CERTIFICATE, ca_cert,
				 ca_cert_len);
	if (ret < 0) {
		LOG_ERR("Failed to add CA certificate: %d", ret);
		goto exit;
	}

exit:
	return ret;
}

int aws_iot_client_init(struct aws_iot_client *client)
{
	if (!client) {
		return -EINVAL;
	}

	memset(client, 0, sizeof(*client));

	// Initialize the embedded MQTT client using the common MQTT abstraction
	int ret = aws_mqtt_client_init(&client->mqtt, MQTT_CLIENT_NAME, AWS_BROKER_PORT,
				       CONFIG_AWS_ENDPOINT, aws_iot_mqtt_event_handler, client);
	if (ret != 0) {
		LOG_ERR("Failed to initialize MQTT client: %d", ret);
		return ret;
	}

	client->messages_received_counter = 0;
	client->do_publish = false;
	client->do_subscribe = false;

	return 0;
}

int aws_iot_resolve_broker_addr(struct aws_iot_client *client)
{
	if (!client) {
		return -EINVAL;
	}
	// Use the MQTT abstraction to resolve the broker address
	return aws_mqtt_resolve_broker_addr(&client->mqtt, CONFIG_AWS_ENDPOINT);
}

int aws_iot_client_connect(struct aws_iot_client *client)
{
	if (!client) {
		return -EINVAL;
	}
	// Use the MQTT abstraction to connect
	return aws_mqtt_client_connect(&client->mqtt);
}

int aws_iot_subscribe_topic(struct aws_iot_client *client)
{
	if (!client) {
		return -EINVAL;
	}
	// Use the MQTT abstraction to subscribe
	client->do_subscribe = false; // Reset flag after attempting subscription
	return aws_mqtt_subscribe_topic(&client->mqtt, CONFIG_AWS_SUBSCRIBE_TOPIC, CONFIG_AWS_QOS);
}

int aws_iot_publish_counter(struct aws_iot_client *client)
{
	if (!client) {
		return -EINVAL;
	}

	struct aws_iot_publish_payload pl = {.counter = client->messages_received_counter};
	size_t payload_len;

	// Encode payload to JSON
	int ret = json_obj_encode_buf(json_descr, ARRAY_SIZE(json_descr), &pl, client->app_buffer,
				      sizeof(client->app_buffer));
	if (ret < 0) {
		LOG_ERR("Failed to encode JSON payload: %d", ret);
		return ret;
	}
	payload_len = strlen((char *)client->app_buffer); // Assuming the JSON is null-terminated

	client->do_publish = false; // Reset flag after attempting publish

	// Use the MQTT abstraction to publish the message
	return aws_mqtt_publish_message(&client->mqtt, CONFIG_AWS_PUBLISH_TOPIC, client->app_buffer,
					payload_len, CONFIG_AWS_QOS);
}

int aws_iot_client_loop(struct aws_iot_client *client)
{
	if (!client) {
		return -EINVAL;
	}

	// Application-specific logic before the MQTT loop
	if (client->do_publish) {
		aws_iot_publish_counter(client);
	}

	if (client->do_subscribe) {
		aws_iot_subscribe_topic(client);
	}

	// Run the generic MQTT client loop
	return aws_mqtt_client_loop(&client->mqtt);
}

int aws_iot_client_disconnect(struct aws_iot_client *client)
{
	if (!client) {
		return -EINVAL;
	}
	// Use the MQTT abstraction to disconnect
	return aws_mqtt_client_disconnect(&client->mqtt);
}

bool aws_iot_client_is_connected(struct aws_iot_client *client)
{
	return client ? aws_mqtt_client_is_connected(&client->mqtt) : false;
}

uint32_t aws_iot_get_messages_received_count(struct aws_iot_client *client)
{
	return client ? client->messages_received_counter : 0;
}
```

## src/aws_iot_core.h
```c
#ifndef AWS_IOT_CORE_H
#define AWS_IOT_CORE_H

#include <stdint.h>
#include <stdbool.h>
#include <zephyr/net/mqtt.h>   // Keep for mqtt_publish_param, etc.
#include <zephyr/net/socket.h> // Keep for sockaddr_in, etc.
#include "aws_mqtt.h"          // Include the new MQTT abstraction header

/**
 * @brief AWS IoT Core client context structure.
 * Now embeds the generic MQTT client.
 */
struct aws_iot_client {
	struct aws_mqtt_client mqtt; /**< Embedded generic MQTT client. */
	uint8_t app_buffer[4096];    /**< Application buffer for receiving/publishing payloads. */
	uint32_t messages_received_counter; /**< Counter for received messages. */
	bool do_publish;                    /**< Flag to trigger publishing. */
	bool do_subscribe;                  /**< Flag to trigger subscription. */
};

/**
 * @brief Payload structure for publishing messages.
 */
struct aws_iot_publish_payload {
	uint32_t counter; /**< Counter value to be published. */
};

/**
 * @brief Setup TLS credentials for AWS IoT connection.
 *
 * @return 0 on success, negative error code on failure.
 */
int aws_iot_setup_credentials(void);

/**
 * @brief Initialize AWS IoT Core client.
 *
 * @param client Pointer to AWS IoT client structure.
 * @return 0 on success, negative error code on failure.
 */
int aws_iot_client_init(struct aws_iot_client *client);

/**
 * @brief Resolve AWS IoT Core broker address.
 *
 * @param client Pointer to AWS IoT client structure.
 * @return 0 on success, negative error code on failure.
 */
int aws_iot_resolve_broker_addr(struct aws_iot_client *client);

/**
 * @brief Connect to AWS IoT Core with retry logic.
 *
 * @param client Pointer to AWS IoT client structure.
 * @return 0 on success, negative error code on failure.
 */
int aws_iot_client_connect(struct aws_iot_client *client);

/**
 * @brief Subscribe to configured AWS IoT topic.
 *
 * @param client Pointer to AWS IoT client structure.
 * @return 0 on success, negative error code on failure.
 */
int aws_iot_subscribe_topic(struct aws_iot_client *client);

/**
 * @brief Publish counter message using JSON format.
 *
 * @param client Pointer to AWS IoT client structure.
 * @return 0 on success, negative error code on failure.
 */
int aws_iot_publish_counter(struct aws_iot_client *client);

/**
 * @brief Main AWS IoT client loop.
 *
 * @param client Pointer to AWS IoT client structure.
 * @return 0 on success, negative error code on failure.
 */
int aws_iot_client_loop(struct aws_iot_client *client);

/**
 * @brief Disconnect from AWS IoT Core.
 *
 * @param client Pointer to AWS IoT client structure.
 * @return 0 on success, negative error code on failure.
 */
int aws_iot_client_disconnect(struct aws_iot_client *client);

/**
 * @brief Check if client is connected.
 *
 * @param client Pointer to AWS IoT client structure.
 * @return true if connected, false otherwise.
 */
bool aws_iot_client_is_connected(struct aws_iot_client *client);

/**
 * @brief Get received messages counter.
 *
 * @param client Pointer to AWS IoT client structure.
 * @return Number of messages received.
 */
uint32_t aws_iot_get_messages_received_count(struct aws_iot_client *client);

#endif /* AWS_IOT_CORE_H */
```

## src/aws_mqtt.c
```c
#include "aws_mqtt.h"
#include "aws_iot_config.h" // For MQTT_BUFFER_SIZE, etc.
#include <errno.h>
#include <stdio.h>
#include <stdlib.h>
#include <string.h>
#include <zephyr/net/socket.h>
#include <zephyr/net/dns_resolve.h>
#include <zephyr/net/tls_credentials.h>
#include <zephyr/random/random.h>
#include <zephyr/logging/log.h>
#include <zephyr/kernel.h>

LOG_MODULE_REGISTER(aws_mqtt, LOG_LEVEL_DBG);

#if (CONFIG_AWS_MQTT_PORT == 443 && !defined(CONFIG_MQTT_LIB_WEBSOCKET))
static const char *const alpn_list[] = {AWS_ALPN_PROTOCOL};
#endif

// Define default sizes if not provided by config (for compilation outside Zephyr build system)
#ifndef CONFIG_MQTT_RX_BUF_SIZE
#define CONFIG_MQTT_RX_BUF_SIZE 256
#endif
#ifndef CONFIG_MQTT_TX_BUF_SIZE
#define CONFIG_MQTT_TX_BUF_SIZE 256
#endif

// TLS tags are specific to AWS IoT, but since the MQTT client handles TLS setup,
// they are defined here.
static const sec_tag_t sec_tls_tags[] = {
	TLS_TAG_DEVICE_CERTIFICATE,
	TLS_TAG_AWS_CA_CERTIFICATE,
};

/**
 * @brief Converts MQTT event type to a string for logging.
 *
 * @param type The MQTT event type.
 * @return String representation of the event type.
 */
static const char *aws_mqtt_evt_type_to_str(enum mqtt_evt_type type)
{
	static const char *const types[] = {
		"CONNACK", "DISCONNECT", "PUBLISH", "PUBACK",   "PUBREC",
		"PUBREL",  "PUBCOMP",    "SUBACK",  "UNSUBACK", "PINGRESP",
	};

	return (type < ARRAY_SIZE(types)) ? types[type] : "<unknown>";
}

/**
 * @brief Internal callback for MQTT events. It forwards the event to the user-defined callback.
 *
 * @param mqtt_client Pointer to the Zephyr MQTT client structure.
 * @param evt Pointer to the MQTT event.
 */
static void aws_mqtt_internal_event_cb(struct mqtt_client *mqtt_client, const struct mqtt_evt *evt)
{
	struct aws_mqtt_client *client =
		CONTAINER_OF(mqtt_client, struct aws_mqtt_client, mqtt_client);

	LOG_DBG("=> MQTT event: %s [%u] result: %d", aws_mqtt_evt_type_to_str(evt->type), evt->type,
		evt->result);

	if (client->event_cb) {
		client->event_cb(mqtt_client, evt);
	}

	switch (evt->type) {
	case MQTT_EVT_CONNACK:
		client->connected = true;
		break;
	case MQTT_EVT_DISCONNECT:
		client->connected = false;
		break;
	default:
		break;
	}
}

/**
 * @brief Initializes the backoff context for connection retries.
 *
 * @param bo Pointer to the aws_mqtt_backoff_context structure.
 */
static void aws_mqtt_backoff_context_init(struct aws_mqtt_backoff_context *bo)
{
	__ASSERT_NO_MSG(bo != NULL);

	bo->retries_count = 0u;
	bo->max_retries = MAX_RETRIES; // From aws_iot_config.h

#if defined(CONFIG_AWS_EXPONENTIAL_BACKOFF)
	bo->attempt_max_backoff = BACKOFF_EXP_BASE_MS; // From aws_iot_config.h
	bo->max_backoff = BACKOFF_EXP_MAX_MS;          // From aws_iot_config.h
#endif
}

/**
 * @brief Calculates the next backoff delay for connection retries.
 *
 * @param bo Pointer to the aws_mqtt_backoff_context structure.
 * @param next_backoff_ms Pointer to store the calculated next backoff delay in milliseconds.
 */
static void aws_mqtt_backoff_get_next(struct aws_mqtt_backoff_context *bo,
				      uint32_t *next_backoff_ms)
{
	__ASSERT_NO_MSG(bo != NULL);
	__ASSERT_NO_MSG(next_backoff_ms != NULL);

#if defined(CONFIG_AWS_EXPONENTIAL_BACKOFF)
	if (bo->retries_count <= bo->max_retries) {
		*next_backoff_ms = sys_rand32_get() % (bo->attempt_max_backoff + 1u);

		/* Calculate max backoff for the next attempt (~ 2**attempt) */
		bo->attempt_max_backoff = MIN(bo->attempt_max_backoff * 2u, bo->max_backoff);
		bo->retries_count++;
	}
#else
	*next_backoff_ms = BACKOFF_CONST_MS; // From aws_iot_config.h
	bo->retries_count++;
#endif
}

int aws_mqtt_client_init(struct aws_mqtt_client *client, const char *client_id,
			 uint16_t broker_port, const char *endpoint,
			 aws_mqtt_event_handler_t event_cb, void *user_data)
{
	if (!client || !client_id || !endpoint) {
		return -EINVAL;
	}

	memset(client, 0, sizeof(*client));

	mqtt_client_init(&client->mqtt_client);

	client->mqtt_client.broker = &client->broker_addr;
	client->mqtt_client.evt_cb = aws_mqtt_internal_event_cb;
	client->event_cb = event_cb;
	client->user_data = user_data;

	client->mqtt_client.client_id.utf8 = (uint8_t *)client_id;
	client->mqtt_client.client_id.size = strlen(client_id);
	client->mqtt_client.password = NULL;
	client->mqtt_client.user_name = NULL;

	client->mqtt_client.keepalive = CONFIG_MQTT_KEEPALIVE;
	client->mqtt_client.protocol_version = MQTT_VERSION_3_1_1;

	client->mqtt_client.rx_buf = client->rx_buffer;
	client->mqtt_client.rx_buf_size = sizeof(client->rx_buffer);
	client->mqtt_client.tx_buf = client->tx_buffer;
	client->mqtt_client.tx_buf_size = sizeof(client->tx_buffer);

	/* Setup TLS */
	client->mqtt_client.transport.type = MQTT_TRANSPORT_SECURE;
	struct mqtt_sec_config *const tls_config = &client->mqtt_client.transport.tls.config;

	tls_config->peer_verify = TLS_PEER_VERIFY_REQUIRED;
	tls_config->cipher_list = NULL;
	tls_config->sec_tag_list = sec_tls_tags;
	tls_config->sec_tag_count = ARRAY_SIZE(sec_tls_tags);
	tls_config->hostname = endpoint;
	tls_config->cert_nocopy = TLS_CERT_NOCOPY_NONE;

#if (CONFIG_AWS_MQTT_PORT == 443 && !defined(CONFIG_MQTT_LIB_WEBSOCKET))
	tls_config->alpn_protocol_name_list = alpn_list;
	tls_config->alpn_protocol_name_count = ARRAY_SIZE(alpn_list);
#endif

	client->connected = false;

	return 0;
}

int aws_mqtt_resolve_broker_addr(struct aws_mqtt_client *client, const char *endpoint)
{
	if (!client || !endpoint) {
		return -EINVAL;
	}

	int ret;
	struct addrinfo *ai = NULL;

	const struct addrinfo hints = {
		.ai_family = AF_INET,
		.ai_socktype = SOCK_STREAM,
		.ai_protocol = 0,
	};
	char port_string[6] = {0};

	sprintf(port_string, "%d", AWS_BROKER_PORT); // From aws_iot_config.h
	ret = getaddrinfo(endpoint, port_string, &hints, &ai);
	if (ret == 0) {
		char addr_str[INET_ADDRSTRLEN];

		memcpy(&client->broker_addr, ai->ai_addr,
		       MIN(ai->ai_addrlen, sizeof(struct sockaddr_storage)));

		inet_ntop(AF_INET, &client->broker_addr.sin_addr, addr_str, sizeof(addr_str));
		LOG_INF("=> Broker address resolved: %s:%u", addr_str,
			htons(client->broker_addr.sin_port));
	} else {
		LOG_ERR("Failed to resolve hostname err = %d (errno = %d)", ret, errno);
	}

	freeaddrinfo(ai);

	return ret;
}

int aws_mqtt_client_connect(struct aws_mqtt_client *client)
{
	if (!client) {
		return -EINVAL;
	}

	int ret;
	uint32_t backoff_ms;
	struct aws_mqtt_backoff_context bo;

	aws_mqtt_backoff_context_init(&bo);

	while (bo.retries_count <= bo.max_retries) {
		ret = mqtt_connect(&client->mqtt_client);
		if (ret == 0) {
			LOG_INF("=> MQTT client connected.");
			client->connected = true;
			goto exit;
		}

		aws_mqtt_backoff_get_next(&bo, &backoff_ms);

		LOG_ERR("Failed to connect: %d backoff delay: %u ms", ret, backoff_ms);
		k_msleep(backoff_ms);
	}

exit:
	return ret;
}

int aws_mqtt_subscribe_topic(struct aws_mqtt_client *client, const char *topic, enum mqtt_qos qos)
{
	if (!client || !topic) {
		return -EINVAL;
	}

	int ret;
	struct mqtt_topic topics[] = {{
		.topic = {.utf8 = topic, .size = strlen(topic)},
		.qos = qos,
	}};
	const struct mqtt_subscription_list sub_list = {
		.list = topics,
		.list_count = ARRAY_SIZE(topics),
		.message_id = 1u,
	};

	LOG_INF("=> SUBSCRIBING to %hu topic(s): \"%s\" (QoS %d)", sub_list.list_count, topic, qos);

	ret = mqtt_subscribe(&client->mqtt_client, &sub_list);
	if (ret != 0) {
		LOG_ERR("Failed to subscribe to topic \"%s\": %d", topic, ret);
	}

	return ret;
}

int aws_mqtt_publish_message(struct aws_mqtt_client *client, const char *topic, uint8_t *payload,
			     size_t payload_len, enum mqtt_qos qos)
{
	if (!client || !topic || !payload) {
		return -EINVAL;
	}

	static uint32_t message_id = 1u; // Static to maintain across calls

	int ret;
	struct mqtt_publish_param msg;

	msg.retain_flag = 0u;
	msg.dup_flag = 0u;
	msg.message.topic.topic.utf8 = (uint8_t *)topic;
	msg.message.topic.topic.size = strlen(topic);
	msg.message.topic.qos = qos;
	msg.message.payload.data = payload;
	msg.message.payload.len = payload_len;
	msg.message_id = message_id++;

	ret = mqtt_publish(&client->mqtt_client, &msg);
	if (ret != 0) {
		LOG_ERR("Failed to publish message: %d", ret);
	}

	LOG_INF("=> PUBLISHED on topic \"%s\" [ id: %u qos: %u ], payload: %u B", topic,
		msg.message_id, msg.message.topic.qos, payload_len);
	LOG_HEXDUMP_DBG(payload, payload_len, "Published payload:");

	return ret;
}

int aws_mqtt_client_loop(struct aws_mqtt_client *client)
{
	if (!client) {
		return -EINVAL;
	}

	int rc;
	int timeout;
	struct pollfd fds;

	if (!client->connected) {
		LOG_WRN("=> Client not connected, cannot run loop.");
		return -ENOTCONN;
	}

	// Setup pollfd for the MQTT client's socket
	fds.fd = client->mqtt_client.transport.tcp.sock;
	fds.events = POLLIN;

	// Loop indefinitely, handling MQTT communication
	for (;;) {
		// Calculate the time remaining until the next MQTT keep-alive
		timeout = mqtt_keepalive_time_left(&client->mqtt_client);
		if (timeout < 0) {
			LOG_ERR("Error getting keepalive time left: %d", timeout);
			return timeout;
		}

		// Wait for socket events or keep-alive timeout
		rc = poll(&fds, 1u, timeout);

		if (rc < 0) {
			LOG_ERR("poll failed: %d", rc);
			break; // Exit loop on poll error
		}

		if (rc > 0) { // Events occurred on the socket
			if (fds.revents & POLLIN) {
				// Data is available to read from the socket
				rc = mqtt_input(&client->mqtt_client);
				if (rc != 0) {
					LOG_ERR("Failed to read MQTT input: %d", rc);
					break; // Exit loop on input error
				}
			}

			if (fds.revents & (POLLHUP | POLLERR)) {
				// Socket was closed or an error occurred
				LOG_ERR("Socket closed/error");
				client->connected = false; // Update connection status
				break;                     // Exit loop
			}
		}

		// Process MQTT keep-alive and handle outgoing messages
		rc = mqtt_live(&client->mqtt_client);
		if ((rc != 0) && (rc != -EAGAIN)) {
			// -EAGAIN means no data was ready, which is fine
			LOG_ERR("Failed to keep MQTT alive: %d", rc);
			break; // Exit loop on live error
		}
	}

	return rc; // Return the last error code or 0 if loop exited cleanly
}

int aws_mqtt_client_disconnect(struct aws_mqtt_client *client)
{
	if (!client) {
		return -EINVAL;
	}

	int ret = mqtt_disconnect(&client->mqtt_client, NULL);
	client->connected = false;

	if (client->mqtt_client.transport.tcp.sock >= 0) {
		close(client->mqtt_client.transport.tcp.sock);
		client->mqtt_client.transport.tcp.sock = -1;
	}

	LOG_INF("=> MQTT client disconnected.");

	return ret;
}

bool aws_mqtt_client_is_connected(struct aws_mqtt_client *client)
{
	return client ? client->connected : false;
}
```

## src/aws_mqtt.h
```c
#ifndef AWS_MQTT_H
#define AWS_MQTT_H

#include <stdint.h>
#include <stdbool.h>
#include <zephyr/net/mqtt.h>
#include <zephyr/net/socket.h>
#include "aws_iot_config.h" // Include for MQTT_BUFFER_SIZE, MAX_RETRIES, etc.

/**
 * @brief MQTT event handler callback function type.
 * This function will be called by the aws_mqtt module when an MQTT event occurs.
 *
 * @param client Pointer to the aws_mqtt_client structure.
 * @param evt Pointer to the MQTT event structure.
 */
typedef void (*aws_mqtt_event_handler_t)(struct mqtt_client *mqtt_client,
					 const struct mqtt_evt *evt);

/**
 * @brief Generic MQTT client context structure.
 * This structure holds all necessary information for an MQTT client.
 */
struct aws_mqtt_client {
	struct mqtt_client mqtt_client;      /**< Zephyr MQTT client instance. */
	struct sockaddr_in broker_addr;      /**< Broker address. */
	uint8_t rx_buffer[MQTT_BUFFER_SIZE]; /**< Receive buffer for MQTT messages. */
	uint8_t tx_buffer[MQTT_BUFFER_SIZE]; /**< Transmit buffer for MQTT messages. */
	bool connected;                      /**< Connection status. */
	aws_mqtt_event_handler_t event_cb;   /**< Callback for MQTT events. */
	void *user_data;                     /**< User-defined data passed to the event callback. */
};

/**
 * @brief Backoff context for connection retry logic.
 */
struct aws_mqtt_backoff_context {
	uint16_t retries_count; /**< Current retry attempt count. */
	uint16_t max_retries;   /**< Maximum number of retries. */
#if defined(CONFIG_AWS_EXPONENTIAL_BACKOFF)
	uint32_t attempt_max_backoff; /**< Maximum backoff for the current attempt (ms). */
	uint32_t max_backoff;         /**< Global maximum backoff (ms). */
#endif
};

/**
 * @brief Initialize the generic MQTT client.
 *
 * @param client Pointer to the aws_mqtt_client structure to initialize.
 * @param client_id MQTT client ID.
 * @param broker_port MQTT broker port.
 * @param endpoint MQTT broker endpoint hostname.
 * @param event_cb Callback function to handle MQTT events.
 * @param user_data User-defined data to be passed to the event callback.
 * @return 0 on success, negative error code on failure.
 */
int aws_mqtt_client_init(struct aws_mqtt_client *client, const char *client_id,
			 uint16_t broker_port, const char *endpoint,
			 aws_mqtt_event_handler_t event_cb, void *user_data);

/**
 * @brief Resolve the MQTT broker address.
 *
 * @param client Pointer to the aws_mqtt_client structure.
 * @param endpoint The hostname of the MQTT broker.
 * @return 0 on success, negative error code on failure.
 */
int aws_mqtt_resolve_broker_addr(struct aws_mqtt_client *client, const char *endpoint);

/**
 * @brief Connect to the MQTT broker with retry logic.
 *
 * @param client Pointer to the aws_mqtt_client structure.
 * @return 0 on success, negative error code on failure.
 */
int aws_mqtt_client_connect(struct aws_mqtt_client *client);

/**
 * @brief Subscribe to an MQTT topic.
 *
 * @param client Pointer to the aws_mqtt_client structure.
 * @param topic The topic string to subscribe to.
 * @param qos The desired QoS level for the subscription.
 * @return 0 on success, negative error code on failure.
 */
int aws_mqtt_subscribe_topic(struct aws_mqtt_client *client, const char *topic, enum mqtt_qos qos);

/**
 * @brief Publish a message to an MQTT topic.
 *
 * @param client Pointer to the aws_mqtt_client structure.
 * @param topic Topic string.
 * @param payload Payload data.
 * @param payload_len Payload data length.
 * @param qos QoS level for the publish message.
 * @return 0 on success, negative error code on failure.
 */
int aws_mqtt_publish_message(struct aws_mqtt_client *client, const char *topic, uint8_t *payload,
			     size_t payload_len, enum mqtt_qos qos);

/**
 * @brief Main MQTT client loop. This function handles MQTT input/output and keepalives.
 *
 * @param client Pointer to the aws_mqtt_client structure.
 * @return 0 on success, negative error code on failure (e.g., socket error, disconnect).
 */
int aws_mqtt_client_loop(struct aws_mqtt_client *client);

/**
 * @brief Disconnect from the MQTT broker.
 *
 * @param client Pointer to the aws_mqtt_client structure.
 * @return 0 on success, negative error code on failure.
 */
int aws_mqtt_client_disconnect(struct aws_mqtt_client *client);

/**
 * @brief Check if the MQTT client is connected.
 *
 * @param client Pointer to the aws_mqtt_client structure.
 * @return true if connected, false otherwise.
 */
bool aws_mqtt_client_is_connected(struct aws_mqtt_client *client);

#endif /* AWS_MQTT_H */
```

## src/heartbeat.c
```c
#include "heartbeat.h"
#include <errno.h>
#include <stdio.h>
#include <string.h>
#include <zephyr/drivers/gpio.h>
#include <zephyr/kernel.h>

#define SLEEP_TIME_MS 500
#define LED0_NODE     DT_ALIAS(led0)

void heartbeat_task(void)
{
	int ret;
	static const struct gpio_dt_spec led = GPIO_DT_SPEC_GET(LED0_NODE, gpios);

	if (!device_is_ready(led.port)) {
		return;
	}

	ret = gpio_pin_configure_dt(&led, GPIO_OUTPUT_ACTIVE);
	if (ret < 0) {
		return;
	}

	while (true) {
		gpio_pin_toggle_dt(&led);
		k_sleep(K_MSEC(SLEEP_TIME_MS));
	}
}
```
